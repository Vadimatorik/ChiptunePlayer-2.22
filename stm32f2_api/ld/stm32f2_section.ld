/* 
 * В данный файл описывает порядок расположения секций в памяти
 * микроконтроллера.
 */
/* Вершина стека (этот адрес будет размещен в таблице векторов прерываний). */
_stack = ORIGIN(RAM) + LENGTH(RAM);

SECTIONS
{
  /* Таблица векторов прерываний, выравниванная по 4 байта (во flash). */
  .irq_table :
  {
    . = ALIGN(4);               /* Задаем счетчику адрес кратный 4-м байтам. */
    KEEP(*(.irq_table))         /* Отключаем оптимизацию сборщика мусора (KEEP). */
    /* Иначе говоря, даже если массив векторов прерываний
       не используется программой, его обязательно следует разместить во flash. */	
    . = ALIGN(4);
  } >FLASH

  .text :
  {
    . = ALIGN(4);
    *(.text)                    /* Основная программа во flash. */
    . = ALIGN(4);
    *(.rodata)                  /* Неизменяемые данные во flash. */
    . = ALIGN(4);      
  } >FLASH

  /* ARM magic sections */
  /* Не ясно, для чего нужная секция, но без нее не собирается. */
  .ARM.extab :
  {
       *(.ARM.extab* .gnu.linkonce.armextab.*)
  } > FLASH
   	
  __exidx_start = .;   	
  .ARM.exidx :
  {
    *(.ARM.exidx* .gnu.linkonce.armexidx.*)
  } > FLASH
  __exidx_end = .;

  /* Изменяемые данные, в RAM1 (копируются из flash). */
  _sidata = ALIGN(4);           /* Получаем адрес дубликата исходных значений изменяемых данных (расположенных в RAM). */

  .data : AT ( _sidata )        /* Секция располагается в RAM, но продублирована во flash. */
  {
    . = ALIGN(4);               /* Обязательно выравниваем по 4-м байтам. */
    _sdata = .;                 /* Получаем значения указателей на начало и конец области .data в RAM. */
    *(.data)     
    . = ALIGN(4);
    _edata = .;    
  } >RAM1                       


  /* Данные в RAM1, изначально 0 (заполняются нулями при инициализации). */
  .bss (NOLOAD) :
  {
    . = ALIGN(4);
    __bss_start__ = .;          /* Получаем указатели на .bss область памяти в RAM. */
    *(.bss)
    . = ALIGN(4);
    __bss_end__ = .;
  } >RAM1
}


